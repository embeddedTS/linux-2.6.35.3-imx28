## arch/arm/mach-mx28/Kconfig
```kconfig
choice
	prompt "Select i.MXS board type"

config MACH_MX28EVK
	bool "Freescale MX28 EVK board"
	depends on ARCH_MX28
	select USB_ARCH_HAS_EHCI

config MACH_TS7600
	bool "Technologic System TS-7600/TS-4600 series"
	depends on ARCH_MX28
	select USB_ARCH_HAS_EHCI

config MACH_TS7400
	bool "Technologic System TS-7400/TS-7670 series"
	depends on ARCH_MX28
	select USB_ARCH_HAS_EHCI

endchoice

config VECTORS_PHY_ADDR
	int "vectors address"
	default 0
	help
	  This config set vectors table is located which physical address

config MXS_TIMER_WITH_MACH
	bool "System Timer support Compare Match interrupt"
	default y

config MEM_mDDR
	bool "Memory type is mDDR"
	depends on ARCH_MX28
	help
	  Say Y to select mDDR memory

config MX28_ENET_ISSUE
	bool "Enable MX28 enet issue fix - Read help!"
	depends on ARCH_MX28
	help
		Say Y to enable a fix for link up/down issue on mx28.
		It is STRONGLY! recommended to always have external oscillators
		provide the clock to ENET PHY and FEC unit.

config MX28_SUSPEND_TO_RAM
	bool "support MX28 suspend-to RAM feature"
  default n
	depends on ARCH_MX28
	help
	  Say Y to enable suspend-to-RAM

config WORKAROUND_ARCUSB_REG_RW
        bool "work around mx28 arch register write for USB"
        help
           MX28 require read ARC register before write. Use SWP intructure to
           implement this requirement.
```
